## config/west.yml
```yaml
manifest:
  remotes:
    - name: zmkfirmware
      url-base: https://github.com/zmkfirmware
    - name: mouse-ft
      url-base: https://github.com/ftc
  projects:
    - name: zmk
      remote: mouse-ft
      revision: main
      import: app/west.yml
  self:
    path: config
```
